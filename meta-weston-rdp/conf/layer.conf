## meta-weston-rdp/conf/layer.conf
```bitbake
# We have a conf and classes directory, add to BBPATH
BBPATH .= ":${LAYERDIR}"

# We have recipes-* directories, add to BBFILES
BBFILES += "${LAYERDIR}/recipes-*/*/*.bb \
            ${LAYERDIR}/recipes-*/*/*.bbappend"

BBFILE_COLLECTIONS += "meta-weston-rdp"
BBFILE_PATTERN_meta-weston-rdp = "^${LAYERDIR}/"
BBFILE_PRIORITY_meta-weston-rdp = "6"

LAYERDEPENDS_meta-weston-rdp = "core"
LAYERSERIES_COMPAT_meta-weston-rdp = "kirkstone"
```

## meta-weston-vnc/conf/layer.conf
```bitbake
# We have a conf and classes directory, add to BBPATH
BBPATH .= ":${LAYERDIR}"

# We have recipes-* directories, add to BBFILES
BBFILES += "${LAYERDIR}/recipes-*/*/*.bb \
            ${LAYERDIR}/recipes-*/*/*.bbappend"

BBFILE_COLLECTIONS += "meta-weston-vnc"
BBFILE_PATTERN_meta-weston-vnc = "^${LAYERDIR}/"
BBFILE_PRIORITY_meta-weston-vnc = "6"

LAYERDEPENDS_meta-weston-vnc = "core"
LAYERSERIES_COMPAT_meta-weston-vnc = "nanbield"
```
